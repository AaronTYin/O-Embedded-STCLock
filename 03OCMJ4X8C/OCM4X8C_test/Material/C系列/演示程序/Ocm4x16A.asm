;********************OCM4x16********************
RW	EQU	P3.0
E1	EQU	P3.1
E2	EQU	P3.2
RS	EQU	P3.3
RST	EQU	P3.4
CHOE1	EQU	20H.0
CHOE2	EQU	20H.1
;/*choe1为1,控制上半屏,choe2为1,控制下半屏*/

LCD_X	EQU	30H
LCD_Y	EQU	31H
LCD_X1	EQU	32H
LCD_Y1	EQU	33H
COUNT	EQU	34H
COUNT1	EQU	35H
COUNT2	EQU	36H
COUNT3	EQU	37H
LCD_DATA	EQU	38H
LCD_DATA1	EQU	39H
LCD_DATA2	EQU	3AH
;***********************************************
		ORG	0000H
		LJMP	MAIN
		ORG	0100H
MAIN:		MOV	SP,#5FH
		LCALL	DELAY2
		CLR	RST
		NOP
		SETB	RST
;********************初始化**********************
LGS0:		SETB	CHOE1
		SETB	CHOE2
		
		MOV	A,#34H			;34H--扩充指令操作
		LCALL	SEND_I
		MOV	A,#30H			;30H--基本指令操作
		LCALL	SEND_I
		MOV	A,#01H			;清除显示
		LCALL	SEND_I
;		LCALL	DELAY2
;		LCALL	DELAY2
		MOV	A,#06H			;指定在资料写入或读取时，光标的移动方向
		LCALL	SEND_I
		MOV	A,#0CH			;开显示,关光标,不闪烁
		LCALL	SEND_I
;***********************************************
LGS1:		MOV	DPTR,#TAB1		;显示汉字和字符
		SETB	CHOE1
		CLR	CHOE2
		MOV	COUNT,#40H
		MOV	A,#80H
		LCALL	SEND_I
LGS11:		CLR	A
		MOVC	A,@A+DPTR
		LCALL	SEND_D
		INC	DPTR
		DJNZ	COUNT,LGS11
		
		CLR	CHOE1
		SETB	CHOE2
		MOV	COUNT,#40H
		MOV	A,#80H
		LCALL	SEND_I
LGS12:		CLR	A
		MOVC	A,@A+DPTR
		LCALL	SEND_D
		INC	DPTR
		DJNZ	COUNT,LGS12
		LCALL	DELAY3
;$$$$$$$$$$$$$$$$$$$$$$$$$$$$$$$$$$$$$$$$$$$$$$$
LGS2:		SETB	CHOE1			;显示点阵
		SETB	CHOE2
		
		MOV	A,#01H
		LCALL	SEND_I
		MOV	LCD_DATA1,#0CCH
		MOV	LCD_DATA2,#0CCH
		LCALL	WRLATTICE
		LCALL	DELAY3
;$$$$$$$$$$$$$$$$$$$$$$$$$$$$$$$$$$$$$$$$$$$$$$$
LGS3:		MOV	A,#34H			;显示汉字和字符
		LCALL	SEND_I
		MOV	A,#30H
		LCALL	SEND_I
		
		SETB	CHOE1
		CLR	CHOE2
		MOV	LCD_DATA,#02H
		MOV	COUNT,#3EH
		MOV	A,#81H
		LCALL	SEND_I
LGS31:		MOV	A,LCD_DATA
		LCALL	SEND_D
		INC	LCD_DATA
		DJNZ	COUNT,LGS31
		
		CLR	CHOE1
		SETB	CHOE2
		MOV	COUNT,#40H
		MOV	A,#80H
		LCALL	SEND_I
LGS32:		MOV	A,LCD_DATA
		LCALL	SEND_D
		INC	LCD_DATA
		DJNZ	COUNT,LGS32
		LCALL	DELAY3
;$$$$$$$$$$$$$$$$$$$$$$$$$$$$$$$$$$$$$$$$$$$$$$$
LGS4:		SETB	CHOE1			;显示点阵
		SETB	CHOE2
		
		MOV	A,#01H
		LCALL	SEND_I
		MOV	LCD_DATA1,#0FFH
		MOV	LCD_DATA2,#00H
		LCALL	WRLATTICE
		LCALL	DELAY3
;$$$$$$$$$$$$$$$$$$$$$$$$$$$$$$$$$$$$$$$$$$$$$$$
LGS5:		MOV	DPTR,#TAB5		;显示图形
		LCALL	PHO_DISP
		LCALL	DELAY3
;$$$$$$$$$$$$$$$$$$$$$$$$$$$$$$$$$$$$$$$$$$$$$$$
		SETB	CHOE1
		SETB	CHOE2
		MOV	A,#34H
		LCALL	SEND_I
		MOV	A,#30H
		LCALL	SEND_I
		LJMP	LGS1
;***********************************************
PHO_DISP:	MOV	LCD_X,#80H		;全屏显示图形子程序
		MOV	LCD_Y1,#80H
		SETB	CHOE1
		CLR	CHOE2
		MOV	COUNT3,#02H
PHO_DISP1:	MOV	COUNT2,#20H
PHO_DISP2:	MOV	COUNT1,#10H
		MOV	LCD_X1,LCD_X
PHO_DISP3:	LCALL	WR_ZB
		CLR	A
		MOVC	A,@A+DPTR
		LCALL	SEND_D
		INC	DPTR
		CLR	A
		MOVC	A,@A+DPTR
		LCALL	SEND_D
		INC	DPTR
		INC	LCD_X1
		DJNZ	COUNT1,PHO_DISP3
		INC	LCD_Y1
		DJNZ	COUNT2,PHO_DISP2
		CLR	CHOE1
		SETB	CHOE2
		MOV	LCD_Y1,#80H
		DJNZ	COUNT3,PHO_DISP1
		
		SETB	CHOE1
		SETB	CHOE2
		MOV	A,#36H
		LCALL	SEND_I
;		LCALL	DELAY1
		MOV	A,#30H
		LCALL	SEND_I
		RET
;$$$$$$$$$$$$$$$$$$$$$$$$$$$$$$$$$$$$$$$$$$$$$$$
CLRRAM:		SETB	CHOE1
		SETB	CHOE2
		MOV	LCD_DATA1,#00H		;GDRAM写0子程序
		MOV	LCD_DATA2,#00H
		LCALL	WRLATTICE
		RET
;$$$$$$$$$$$$$$$$$$$$$$$$$$$$$$$$$$$$$$$$$$$$$$$
WRLATTICE:	MOV	LCD_X,#80H		;显示点阵子程序
		MOV	LCD_Y1,#80H
WRLAT1:		CLR	F0
		MOV	COUNT2,#20H
WRLAT2:		MOV	COUNT1,#10H
		MOV	LCD_X1,LCD_X
WRLAT3:		JB	F0,WRLAT32
		MOV	LCD_DATA,LCD_DATA1
		AJMP	WRLAT31
WRLAT32:	MOV	LCD_DATA,LCD_DATA2
WRLAT31:	LCALL	WR_ZB
		MOV	A,LCD_DATA
		LCALL	SEND_D
		MOV	A,LCD_DATA
		LCALL	SEND_D
		INC	LCD_X1
		DJNZ	COUNT1,WRLAT3
		INC	LCD_Y1
		CPL	F0
		DJNZ	COUNT2,WRLAT2
		
		MOV	A,#36H
		LCALL	SEND_I
;		LCALL	DELAY1
		MOV	A,#30H
		LCALL	SEND_I
		RET
;$$$$$$$$$$$$$$$$$$$$$$$$$$$$$$$$$$$$$$$$$$$$$$$
WR_ZB:		MOV	A,#34H
		LCALL	SEND_I
;		LCALL	DELAY1
		MOV	A,LCD_Y1
		LCALL	SEND_I
		MOV	A,LCD_X1
		LCALL	SEND_I
		MOV	A,#30H
		LCALL	SEND_I
		RET
;***********************************************
SEND_D:		LCALL	CHK_BUSY		;写数据子程序
		SETB	RS
		CLR	RW
		MOV	P1,A
		JNB	CHOE1,SEND_D2
		SETB	E1
		NOP
		NOP
		CLR	E1
SEND_D2:	JNB	CHOE2,SEND_D1
		SETB	E2
		NOP
		NOP
		CLR	E2
SEND_D1:	NOP
		RET

SEND_I:		LCALL	CHK_BUSY		;写指令子程序
		CLR	RS
		CLR	RW
		MOV	P1,A
		JNB	CHOE1,SEND_I2
		SETB	E1
		NOP
		NOP
		CLR	E1
SEND_I2:	JNB	CHOE2,SEND_I1
		SETB	E2
		NOP
		NOP
		CLR	E2
SEND_I1:	NOP
		RET

CHK_BUSY:	JNB	CHOE1,CHK_BUSY2		;测忙碌子程序
		MOV	P1,#0FFH
		CLR	RS
		SETB	RW
		SETB	E1
		JB	P1.7,$
		CLR	E1
CHK_BUSY2:	JNB	CHOE2,CHK_BUSY1
		MOV	P1,#0FFH
		CLR	RS
		SETB	RW
		SETB	E2
		JB	P1.7,$
		CLR	E2
CHK_BUSY1:	NOP
		RET
;***********************************************
DELAY3:		MOV	R5,#16H
DEL31:		MOV	R6,#0FFH
DEL32:		MOV	R7,#0FFH
DEL33:		DJNZ	R7,DEL33
		DJNZ	R6,DEL32
		DJNZ	R5,DEL31
		RET

DELAY2:		MOV	R6,#0CH
DEL21:		MOV	R7,#18H
DEL22:		DJNZ	R7,DEL22
		DJNZ	R6,DEL21
		RET

DELAY1:		MOV	R6,#06H
DEL11:		MOV	R7,#08H
DEL12:		DJNZ	R7,DEL12
		DJNZ	R6,DEL11
		RET
;***********************************************
TAB1:	DB 0B1H,0BEH,0C4H,0A3H,0BFH,0E9H,0C4H,0DAH,0D6H,0C3H,0B6H,0FEH,0BCH,0B6H,0D7H,0D6H
	DB 0BFH,0E2H,0D2H,0D4H,0BCH,0B0H,0B9H,0A6H,0C4H,0DCH,0B7H,0E1H,0B8H,0BBH,0B5H,0C4H
	DB 0D3H,0C3H,0BBH,0A7H,0D6H,0B8H,0C1H,0EEH,0CAH,0B9H,0D3H,0C3H,0B8H,0FCH,0B7H,0BDH
	DB 0B1H,0E3H,0B8H,0FCH,0C1H,0E9H,0BBH,0EEH,0BBH,0B6H,0D3H,0ADH,0C0H,0B4H,0BAH,0AFH
	DB 0C0H,0B4H,0B5H,0E7H,0B4H,0B9H,0D1H,0AFH,0BBH,0F2H,0D5H,0DFH,0BFH,0C9H,0CDH,0A8H
	DB 0B9H,0FDH,0B5H,0E7H,0D7H,0D3H,0D3H,0CAH,0BCH,0FEH,0B4H,0ABH,0D5H,0E6H,0D3H,0EBH
	DB 0CEH,0D2H,0C3H,0C7H,0C1H,0AAH,0CFH,0B5H,0BBH,0B6H,0D3H,0ADH,0B6H,0A9H,0B9H,0BAH
	DB 0BDH,0F0H,0C5H,0F4H,0BFH,0C6H,0BCH,0BCH,0D3H,0D0H,0CFH,0DEH,0B9H,0ABH,0CBH,0BEH
TAB5:
;--  调入了一幅图像：F:\梁\画图\HOCO25664.bmp  --
;--  宽度x高度=256x64  --
DB  000H,000H,000H,000H,000H,000H,000H,000H,000H,000H,000H,000H,000H,000H,000H,000H
DB  000H,000H,000H,000H,000H,000H,000H,000H,000H,000H,000H,000H,000H,000H,000H,000H
DB  000H,000H,000H,000H,000H,000H,000H,000H,000H,000H,000H,000H,000H,000H,000H,000H
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DB  000H,000H,000H,000H,000H,000H,000H,000H,000H,000H,000H,000H,000H,000H,000H,000H

		END
