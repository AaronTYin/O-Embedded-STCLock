;******************OCM4x8C串口******************
CS	EQU	P3.0
STD	EQU	P3.1
SCLK	EQU	P3.2
PSB	EQU	P3.3
RST	EQU	P3.5
RS_STU	EQU	20H.0

LCD_X	EQU	30H
LCD_Y	EQU	31H
LCD_X1	EQU	32H
LCD_Y1	EQU	33H
COUNT	EQU	34H
COUNT1	EQU	35H
COUNT2	EQU	36H
COUNT3	EQU	37H
LCD_DATA	EQU	38H
LCD_DATA1	EQU	39H
LCD_DATA2	EQU	3AH
DA_IN		EQU	3BH
WR_COUNT1	EQU	3CH
WR_COUNT2	EQU	3DH
;***********************************************
		ORG	0000H
		LJMP	MAIN
		ORG	0100H
MAIN:		NOP
		NOP
		MOV	SP,#5FH
		SETB	RST
		CLR	PSB
;********************初始化**********************
LGS0:		MOV	A,#34H			;34H--扩充指令操作
		LCALL	SEND_I
		MOV	A,#30H			;30H--基本指令操作
		LCALL	SEND_I
		MOV	A,#01H			;清除显示
		LCALL	SEND_I
		LCALL	DELAY2
		LCALL	DELAY2
		MOV	A,#06H			;指定在资料写入或读取时，光标的移动方向
		LCALL	SEND_I
		MOV	A,#0CH			;开显示,关光标,不闪烁
		LCALL	SEND_I
;***********************************************
LGS1:		MOV	DPTR,#TAB1		;显示汉字和字符
		MOV	COUNT,#40H
		MOV	A,#80H
		LCALL	SEND_I
LGS11:		CLR	A
		MOVC	A,@A+DPTR
		LCALL	SEND_D
		INC	DPTR
		DJNZ	COUNT,LGS11
		LCALL	DELAY3
;$$$$$$$$$$$$$$$$$$$$$$$$$$$$$$$$$$$$$$$$$$$$$$$
LGS2:		MOV	A,#01H
		LCALL	SEND_I
		LCALL	DELAY2
		LCALL	DELAY2

		MOV	LCD_DATA1,#0CCH		;显示点阵
		MOV	LCD_DATA2,#0CCH
		LCALL	LAT_DISP
		LCALL	DELAY3
;$$$$$$$$$$$$$$$$$$$$$$$$$$$$$$$$$$$$$$$$$$$$$$$
LGS3:		MOV	A,#34H
		LCALL	SEND_I
		MOV	A,#30H
		LCALL	SEND_I

		MOV	DPTR,#TAB3		;显示汉字和字符
		MOV	COUNT,#40H
		MOV	A,#80H
		LCALL	SEND_I
LGS31:		CLR	A
		MOVC	A,@A+DPTR
		LCALL	SEND_D
		INC	DPTR
		DJNZ	COUNT,LGS31
		LCALL	DELAY3
;$$$$$$$$$$$$$$$$$$$$$$$$$$$$$$$$$$$$$$$$$$$$$$$
LGS4:		MOV	A,#01H
		LCALL	SEND_I
		LCALL	DELAY2
		LCALL	DELAY2

		MOV	LCD_DATA1,#0FFH		;显示点阵
		MOV	LCD_DATA2,#00H
		LCALL	LAT_DISP
		LCALL	DELAY3
;$$$$$$$$$$$$$$$$$$$$$$$$$$$$$$$$$$$$$$$$$$$$$$$
LGS5:		MOV	DPTR,#TAB5		;显示图形
		LCALL	PHO_DISP
		LCALL	DELAY3
;$$$$$$$$$$$$$$$$$$$$$$$$$$$$$$$$$$$$$$$$$$$$$$$
		MOV	A,#34H
		LCALL	SEND_I
		MOV	A,#30H
		LCALL	SEND_I
		LJMP	LGS1
;***********************************************
PHO_DISP:	MOV	COUNT3,#02H		;全屏显示图形子程序
		MOV	LCD_X,#80H
PHO_DISP1:	MOV	LCD_Y,#80H
		MOV	COUNT2,#20H
PHO_DISP2:	MOV	COUNT1,#10H
		LCALL	WR_ZB
PHO_DISP3:	CLR	A
		MOVC	A,@A+DPTR
		LCALL	SEND_D
		INC	DPTR
		DJNZ	COUNT1,PHO_DISP3
		INC	LCD_Y
		DJNZ	COUNT2,PHO_DISP2
		MOV	LCD_X,#88H
		DJNZ	COUNT3,PHO_DISP1

		MOV	A,#36H
		LCALL	SEND_I
		MOV	A,#30H
		LCALL	SEND_I
		RET
;$$$$$$$$$$$$$$$$$$$$$$$$$$$$$$$$$$$$$$$$$$$$$$$
CLRRAM:		MOV	LCD_DATA1,#00H		;GDRAM写0子程序
		MOV	LCD_DATA2,#00H
		LCALL	LAT_DISP
		RET
;$$$$$$$$$$$$$$$$$$$$$$$$$$$$$$$$$$$$$$$$$$$$$$$
LAT_DISP:	MOV	COUNT3,#02H		;显示点阵子程序
		MOV	LCD_X,#80H
LAT_DISP1:	MOV	LCD_Y,#80H
		CLR	F0
		MOV	COUNT2,#20H
LAT_DISP2:	MOV	COUNT1,#10H
		LCALL	WR_ZB
LAT_DISP3:	JB	F0,LAT_DISP32
		MOV	LCD_DATA,LCD_DATA1
		AJMP	LAT_DISP31
LAT_DISP32:	MOV	LCD_DATA,LCD_DATA2
LAT_DISP31:	MOV	A,LCD_DATA
		LCALL	SEND_D
		DJNZ	COUNT1,LAT_DISP31
		INC	LCD_Y
		CPL	F0
		DJNZ	COUNT2,LAT_DISP2
		MOV	LCD_X,#88H
		DJNZ	COUNT3,LAT_DISP1

		MOV	A,#36H
		LCALL	SEND_I
		MOV	A,#30H
		LCALL	SEND_I
		RET
;$$$$$$$$$$$$$$$$$$$$$$$$$$$$$$$$$$$$$$$$$$$$$$$
WR_ZB:		MOV	A,#34H
		LCALL	SEND_I
		MOV	A,LCD_Y
		LCALL	SEND_I
		MOV	A,LCD_X
		LCALL	SEND_I
		MOV	A,#30H
		LCALL	SEND_I
		RET
;***********************************************
SEND_D:		SETB	RS_STU			;写数据子程序
		MOV	DA_IN,A
		LCALL	SERIAL_WR
		RET

SEND_I:		CLR	RS_STU			;写指令子程序
		MOV	DA_IN,A
		LCALL	SERIAL_WR
		RET
;$$$$$$$$$$$$$$$$$$$$$$$$$$$$$$$$$$$$$$$$$$$$$$$
;DA_IN:     数据或指令
;RS_STU:    数据指令选择
;WR_COUNT1: 计数器1
;WR_COUNT2: 计数器2

SERIAL_WR:	PUSH	ACC
		MOV	A,DA_IN
		SETB	CS
		
		MOV	WR_COUNT1,#05H
		SETB	STD			;1
SERIAL_WR1:	CLR	SCLK
		SETB	SCLK
		DJNZ	WR_COUNT1,SERIAL_WR1
		
		CLR	STD			;RW
		CLR	SCLK
		SETB	SCLK
		JNB	RS_STU,CLR_RS
		SETB	STD			;写数据
		SJMP	SETB_RS
CLR_RS:		CLR	STD			;写指令
SETB_RS:	CLR	SCLK
		SETB	SCLK
		CLR	STD			;0
		CLR	SCLK
		SETB	SCLK
		
		MOV	WR_COUNT1,#02H
SERIAL_WR2:	MOV	WR_COUNT2,#04H
SERIAL_WR21:	RLC	A
		MOV	STD,C
		CLR	SCLK
		SETB	SCLK
		DJNZ	WR_COUNT2,SERIAL_WR21
		MOV	WR_COUNT2,#04H
		CLR	STD			;0
SERIAL_WR22:	CLR	SCLK
		SETB	SCLK
		DJNZ	WR_COUNT2,SERIAL_WR22
		DJNZ	WR_COUNT1,SERIAL_WR2
		
		CLR	SCLK
		CLR	CS
		LCALL	DELAY2
		POP	ACC
		RET
;***********************************************
DELAY3:		MOV	R5,#16H
DEL31:		MOV	R6,#0FFH
DEL32:		MOV	R7,#0FFH
DEL33:		DJNZ	R7,DEL33
		DJNZ	R6,DEL32
		DJNZ	R5,DEL31
		RET

DELAY2:		MOV	R6,#06H
DEL21:		MOV	R7,#18H
DEL22:		DJNZ	R7,DEL22
		DJNZ	R6,DEL21
		RET
;***********************************************
TAB1:	DB '金鹏科技有限公司'
	DB 'GOLDEN PALM TECH'
	DB '奥可拉液'
	DB 0BEH,0A7H	;晶
	DB '显示器'
	DB 'TEL:0758-2263858'

TAB3:	DB '模块内置二级字库'
	DB '~!@#$%^&*()_+|{}'
	DB '使用更方便更灵活'
	DB 0A2H,0D9H,0A2H,0DAH,0A2H,0DBH,0A2H,0DCH,0A2H,0DDH,0A2H,0DEH,0A2H,0DFH,0A2H,0E0H

TAB5:
DB  00,00,00,00,00,00,00,00,00,00,00,00,00,00,00,00
DB  00,00,00,00,00,00,00,00,00,00,00,00,00,00,00,00
DB  00,00,00,00,01H,80H,00,60H,04H,00,38H,00,00,00,00,00
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DB  00,00,00,00,00,00,00,00,00,00,00,00,00,00,00,00

		END
